## dts/bindings/wifi/renesas,erpc-wifi-spi.yaml
```yaml
# Copyright (c) 2025 Renesas Electronics Corporation
# SPDX-License-Identifier: Apache-2.0

description: Renesas WiFi offload driver (eRPC over SPI)

compatible: "renesas,erpc-wifi-spi"

include:
  - "renesas,erpc-wifi.yaml"
  - "spi-device.yaml"

properties:
  int-gpios:
    required: true
    type: phandle-array
    description: |
      TODO
```

## dts/bindings/wifi/renesas,erpc-wifi-uart.yaml
```yaml
# Copyright (c) 2025 Renesas Electronics Corporation
# SPDX-License-Identifier: Apache-2.0

description: Renesas WiFi offload driver (eRPC over UART)

compatible: "renesas,erpc-wifi-uart"

include:
  - "renesas,erpc-wifi.yaml"
  - "uart-device.yaml"
```
